## configs/KConfig
```kconfig
mainmenu "Project Config"

config PLATFORM_CONFIGS_DIR
	option env="PLATFORM_CONFIGS_DIR"
	string

menu "Project info"
	config PROJECT_NAME
		string "Project name"
		default en3d

	config PROJECT_VERSION_MAJOR
		int "Major version"
		default 0

	config PROJECT_VERSION_MINOR
		int "Minor version"
		default 0

	config PROJECT_VERSION_PATCH
		int "Patch version"
		default 1
endmenu

menu "Engine info"
	config ENGINE_NAME
		string "Engine name"
		default NoEngine

	config ENGINE_VERSION_MAJOR
		int "Major version"
		default 0

	config ENGINE_VERSION_MINOR
		int "Minor version"
		default 0

	config ENGINE_VERSION_PATCH
		int "Patch version"
		default 1
endmenu

menu "Debug"
	if PLATFORM_LINUX || PLATFORM_WINDOWS
		choice
			prompt "Vulkan validation layer"
			default ENABLE_KHRONOS_VALIDATION

			config ENABLE_LUNARG_STANDART_VALIDATION
				bool "LunarG Standard Validation Layer"
			config ENABLE_KHRONOS_VALIDATION
				bool "Khronos Validation Layer"
			config DISABLE_VALIDATION
				bool "Disable validation"
		endchoice

		config ENABLE_DEBUG_UTILS
			bool "Vulkan debug utils"
			default y
	endif
endmenu

choice
	prompt "Target platform"
	default PLATFORM_LINUX

	config PLATFORM_LINUX
		bool "Linux"
	config PLATFORM_WINDOWS
		bool "Windows"
	config PLATFORM_ANDROID
		bool "Android"
	config PLATFORM_WEB
		bool "Web"
endchoice

if PLATFORM_LINUX
	source "$PLATFORM_CONFIGS_DIR/linux.kc"
endif

if PLATFORM_WINDOWS
	source "$PLATFORM_CONFIGS_DIR/windows.kc"
endif

if PLATFORM_ANDROID
	source "$PLATFORM_CONFIGS_DIR/android.kc"
endif

if PLATFORM_WEB
	source "$PLATFORM_CONFIGS_DIR/web.kc"
endif
```
